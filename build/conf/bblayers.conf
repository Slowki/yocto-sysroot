## build/conf/bblayers.conf
```bitbake
# POKY_BBLAYERS_CONF_VERSION is increased each time build/conf/bblayers.conf
# changes incompatibly
POKY_BBLAYERS_CONF_VERSION = "2"

BBPATH = "${TOPDIR}"
BBFILES ?= ""

# Layers can be added with `bitbake-layers add-layer ../meta-clang`
BBLAYERS ?= " \
  /poky/meta \
  /poky/meta-poky \
  /poky/meta-yocto-bsp \
  /poky/meta-clang \
  /poky/meta-custom \
  /poky/meta-intel \
  /poky/meta-openembedded/meta-filesystems \
  /poky/meta-openembedded/meta-networking \
  /poky/meta-openembedded/meta-oe \
  /poky/meta-openembedded/meta-python \
  /poky/meta-raspberrypi \
  "
```

## meta-custom/conf/distro/production.conf
```bitbake
# Enable LTO and fat LTO objects
require conf/distro/include/lto.inc

# LTO = "-flto=full -ffat-lto-objects -fuse-ld=lld ${LTOEXTRA}"

# Disable LTO for musl
LTO:pn-musl = ""

DISTRO_FEATURES = ""
# Right now enabling the LTO distro feature causes the following error:
# dwarfsrcfiles: /poky/build/tmp-musl/work/skylake-64-oe-linux-musl/libcxx/15.0.6-r0/package/usr/lib/libc++abi.a: not a valid ELF file
# DISTRO_FEATURES:append = " lto"
DISTRO_FEATURES:append = " debuginfod"
DISTRO_FEATURES_NATIVESDK:append = " debuginfod"
DISTRO_FEATURES:append = " vulkan"
# Using Vulkan for nativesdk breaks the qemu dependency chain
DISTRO_FEATURES:append = " opengl"
DISTRO_FEATURES_NATIVESDK:append = " opengl"
DISTRO_FEATURES:append = " wayland"
DISTRO_FEATURES_NATIVESDK:append = " wayland"
# For some reason the libgl RPM isn't created unless X11 is enabled
DISTRO_FEATURES:append = " x11"

# Centralized debug file directory, e.g. /bin/foo -> /usr/lib/debug/bin/foo.debug
PACKAGE_DEBUG_SPLIT_STYLE = "debug-file-directory"

LIBCPLUSPLUS = "-stdlib=libc++"
PREFERRED_PROVIDER_libgcc = "compiler-rt"
RUNTIME = "llvm"
# Do I really need the next line?
TC_CXX_RUNTIME = "llvm"
TCLIBC = "musl"
TOOLCHAIN = "clang"

# Use clang in populate_sdk
CLANGSDK = "1"

# Disable systemd
INIT_MANAGER = "none"
```

## meta-custom/conf/machine/x86-builder.conf
```bitbake
MACHINE_FEATURES = "ipv6 usbhost pci"

require conf/machine/intel-skylake-64.conf
```
